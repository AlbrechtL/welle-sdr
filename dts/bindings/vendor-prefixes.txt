## modules/adc_dvp_wch/Kconfig
```kconfig
# Copyright The Zephyr Project Contributors
# SPDX-License-Identifier: Apache-2.0

config ADC_DVP_WCH
	bool "Parallel ADC capture with the WCH DVP"
	default y
	depends on DT_HAS_WCH_DVP_ADC_ENABLED
	depends on PWM
	depends on GPIO
	help
	  Capture driver for an 8-bit parallel ADC such as the AD9280 on the
	  digital video port (DVP) of the WCH CH32V30x. A timer PWM output
	  provides the ADC clock, which is fed back into DVP_PCLK.

if ADC_DVP_WCH

config ADC_DVP_WCH_INIT_PRIORITY
	int "Init priority"
	default 80
	help
	  Device init priority. Must be after the PWM and GPIO drivers.

config ADC_DVP_WCH_BLOCK_SIZE
	int "DMA block size in bytes"
	default 2048
	range 256 16384
	help
	  Number of samples per DMA block. The DVP raises one interrupt per
	  block. Must be a multiple of 4, as the DVP DMA moves 4 bytes per
	  request.

config ADC_DVP_WCH_BLOCK_COUNT
	int "Number of DMA blocks"
	default 4
	range 3 8
	help
	  Number of blocks in the capture ring. Two blocks are always
	  assigned to the DVP DMA, the others hold completed data until the
	  consumer releases them.

module = ADC_DVP_WCH
module-str = adc_dvp_wch
source "subsys/logging/Kconfig.template.log_config"

endif # ADC_DVP_WCH
```

## modules/adc_dvp_wch/dts/bindings/adc/wch,dvp-adc.yaml
```yaml
# Copyright The Zephyr Project Contributors
# SPDX-License-Identifier: Apache-2.0

description: |
  8-bit parallel ADC (such as the AD9280) sampled by the digital video port
  (DVP) of the WCH CH32V30x.

  The DVP runs in JPEG mode, in which it stores a continuous byte stream in
  fixed-size DMA blocks. A timer PWM output generates the ADC clock, which
  is also wired to DVP_PCLK. Two GPIO outputs drive DVP_HSYNC and DVP_VSYNC,
  as the ADC has no line or frame signals.

compatible: "wch,dvp-adc"

include: base.yaml

properties:
  reg:
    required: true

  interrupts:
    required: true

  clocks:
    required: true

  pwms:
    type: phandle-array
    required: true
    description: PWM output that drives the ADC clock (DCLK) and DVP_PCLK.

  hsync-gpios:
    type: phandle-array
    required: true
    description: GPIO output wired to DVP_HSYNC; held active while capturing.

  vsync-gpios:
    type: phandle-array
    required: true
    description: GPIO output wired to DVP_VSYNC; active while capturing.

  input-gpios:
    type: phandle-array
    required: true
    description: |
      DVP input pins (data, PCLK, HSYNC, VSYNC), configured as floating
      inputs at init.
```

## modules/udc_wch_usbhs/Kconfig
```kconfig
# Copyright The Zephyr Project Contributors
# SPDX-License-Identifier: Apache-2.0

config UDC_WCH_USBHS
	bool "WCH USBHS device controller driver"
	default y
	depends on DT_HAS_WCH_USBHS_ENABLED
	depends on UDC_DRIVER
	select UDC_DRIVER_HAS_HIGH_SPEED_SUPPORT
	select SYS_MEM_BLOCKS
	select EVENTS
	help
	  Driver for the USBHS device controller with built-in high-speed
	  PHY found in WCH CH32V305, CH32V307 and CH32V317.

if UDC_WCH_USBHS

config UDC_WCH_USBHS_STACK_SIZE
	int "UDC controller driver internal thread stack size"
	default 768
	help
	  Device controller driver internal thread stack size.

config UDC_WCH_USBHS_THREAD_PRIORITY
	int "UDC controller driver thread priority"
	default 8
	help
	  Device controller driver thread priority.

config UDC_WCH_USBHS_BUF_POOL_SIZE
	int "Endpoint DMA buffer pool size"
	default 2048
	range 512 32768
	help
	  Size of the pool from which the DMA buffers of the non-control
	  endpoints are allocated, in multiples of 64 bytes. A high-speed
	  bulk endpoint needs 512 bytes.

endif # UDC_WCH_USBHS
```

## modules/udc_wch_usbhs/dts/bindings/usb/wch,usbhs.yaml
```yaml
# Copyright The Zephyr Project Contributors
# SPDX-License-Identifier: Apache-2.0

description: |
  WCH USBHS device controller with built-in high-speed PHY
  (CH32V305, CH32V307, CH32V317).

compatible: "wch,usbhs"

include: usb-ep.yaml

properties:
  reg:
    required: true

  interrupts:
    required: true

  clocks:
    required: true
```
